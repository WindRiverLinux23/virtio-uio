## conf/layer.conf
```bitbake
#
# Copyright (c) 2024, Wind River Systems, Inc.
#
# Permission is hereby granted, free of charge, to any person obtaining a copy
# of this software and associated documentation files (the "Software"), to deal
# in the Software without restriction, including without limitation the rights
# to use, copy, modify, merge, publish, distribute, sublicense, and/or sell
# copies of the Software, and to permit persons to whom the Software is
# furnished to do so, subject to the following conditions:
#
# The above copyright notice and this permission notice shall be included in
# all copies or substantial portions of the Software.
#
# THE SOFTWARE IS PROVIDED "AS IS", WITHOUT WARRANTY OF ANY KIND, EXPRESS OR
# IMPLIED, INCLUDING BUT NOT LIMITED TO THE WARRANTIES OF MERCHANTABILITY,
# FITNESS FOR A PARTICULAR PURPOSE AND NONINFRINGEMENT. IN NO EVENT SHALL THE
# AUTHORS OR COPYRIGHT HOLDERS BE LIABLE FOR ANY CLAIM, DAMAGES OR OTHER
# LIABILITY, WHETHER IN AN ACTION OF CONTRACT, TORT OR OTHERWISE, ARISING FROM,
# OUT OF OR IN CONNECTION WITH THE SOFTWARE OR THE USE OR OTHER DEALINGS IN
# THE SOFTWARE.
#

# We have a conf directory, add to BBPATH
BBPATH =. "${LAYERDIR}:"

# We have a recipe directory, add to BBFILES
BBFILES += "${LAYERDIR}/recipes*/*/*.bb \
           ${LAYERDIR}/recipes*/*/*.bbappend"

LAYER_PATH_wr-virtio-uio = "${LAYERDIR}"

BBFILE_COLLECTIONS += "wr-virtio-uio"
BBFILE_PATTERN_wr-virtio-uio = "^${LAYERDIR}/"
BBFILE_PRIORITY_wr-virtio-uio = "7"

LAYERVERSION_wr-virtio-uio = "1"

LAYERSERIES_COMPAT_wr-virtio-uio = "wrl zeus mickledore dunfell"
```
